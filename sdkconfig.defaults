## sdkconfig.defaults
```kconfig
CONFIG_IDF_CMAKE=y
CONFIG_IDF_TARGET="esp32s2"
CONFIG_IDF_TARGET_ESP32S2=y

#
# Partition Table
#
CONFIG_PARTITION_TABLE_CUSTOM=y
CONFIG_PARTITION_TABLE_CUSTOM_FILENAME="partitions_keyboard.csv"
CONFIG_PARTITION_TABLE_FILENAME="partitions_keyboard.csv"
# end of Partition Table

#
# HTTP Server
#
CONFIG_HTTPD_MAX_REQ_HDR_LEN=1024
CONFIG_HTTPD_MAX_URI_LEN=1024
# end of HTTP Server

# HTTPS server used for Spotify authentication.

#
# ESP HTTPS server
#
CONFIG_ESP_HTTPS_SERVER_ENABLE=y
# end of ESP HTTPS server

# CONFIG_FREERTOS_SUPPORT_STATIC_ALLOCATION=y required for TinyUSB.
#
# FreeRTOS
#
CONFIG_FREERTOS_WATCHPOINT_END_OF_STACK=y
CONFIG_FREERTOS_SUPPORT_STATIC_ALLOCATION=y
# end of FreeRTOS

# Remove (Heap memory debugging) section when shipping.

#
# Heap memory debugging
#
CONFIG_HEAP_POISONING_COMPREHENSIVE=y
CONFIG_HEAP_TRACING_OFF=y
CONFIG_HEAP_TASK_TRACKING=y
# end of Heap memory debugging

# Spotify auth headers are larger than default.

#
# LWIP
#
CONFIG_LWIP_LOCAL_HOSTNAME="display-keyboard"
# end of LWIP

#
# LVGL configuration
#
CONFIG_LV_HOR_RES_MAX=320
CONFIG_LV_VER_RES_MAX=320
CONFIG_LV_COLOR_16_SWAP=y

#
# Memory manager settings
#
CONFIG_LV_MEM_SIZE_KILOBYTES=600
# end of Memory manager settings

#
# Image decoder and cache
#
CONFIG_LV_IMG_CACHE_DEF_SIZE=8
# end of Image decoder and cache

#
# Debug Settings
#
CONFIG_LV_USE_DEBUG=y
CONFIG_LV_USE_ASSERT_MEM_INTEGRITY=y
CONFIG_LV_USE_ASSERT_OBJ=y
CONFIG_LV_USE_ASSERT_STYLE=y
# end of Debug Settings

#
# Theme usage
#
CONFIG_LV_THEME_DEFAULT_FLAG_DARK=y
# end of Theme usage
# end of LVGL configuration

#
# LVGL TFT Display controller
#
CONFIG_DISPLAY_ORIENTATION_LANDSCAPE_INVERTED=y
CONFIG_LV_DISPLAY_ORIENTATION=3
CONFIG_CUSTOM_DISPLAY_BUFFER_SIZE=y
CONFIG_CUSTOM_DISPLAY_BUFFER_BYTES=8192
CONFIG_LV_TFT_DISPLAY_SPI_FULL_DUPLEX=y
CONFIG_LV_TFT_USE_CUSTOM_SPI_CLK_DIVIDER=y
CONFIG_LV_TFT_SPI_CLK_DIVIDER_1=y

#
# Display Pin Assignments
#
CONFIG_LV_DISP_SPI_MOSI=35
CONFIG_LV_DISP_SPI_CLK=36
CONFIG_LV_DISP_SPI_CS=7
CONFIG_LV_DISP_PIN_DC=5
CONFIG_LV_DISP_PIN_RST=0
# end of Display Pin Assignments
# end of LVGL TFT Display controller

#
# LVGL Touch controller
#
CONFIG_LV_TOUCH_CONTROLLER=1
CONFIG_LV_TOUCH_CONTROLLER_XPT2046=y
CONFIG_LV_TOUCH_CONTROLLER_SPI_FSPI=y

#
# Touchpanel (XPT2046) Pin Assignments
#
CONFIG_LV_TOUCH_SPI_MISO=37
CONFIG_LV_TOUCH_SPI_MOSI=35
CONFIG_LV_TOUCH_SPI_CLK=36
CONFIG_LV_TOUCH_SPI_CS=10
CONFIG_LV_TOUCH_PIN_IRQ=11
# end of Touchpanel (XPT2046) Pin Assignments
# end of LVGL Touch controller

#
# TarableSSD1306
#
CONFIG_SSD1306_ENABLE_DEFAULT_I2C_INTERFACE=y
CONFIG_SSD1306_DEFAULT_I2C_SPEED=400000
CONFIG_SSD1306_DEFAULT_I2C_PORT_NUMBER=1
CONFIG_SSD1306_DEFAULT_I2C_SCL_PIN=3
CONFIG_SSD1306_DEFAULT_I2C_SDA_PIN=1
# CONFIG_SSD1306_ENABLE_DEFAULT_SPI_INTERFACE is not set
CONFIG_SSD1306_ERROR_ABORT=y
CONFIG_SSD1306_CLIPDEBUG=1
# CONFIG_CLIPDEBUG_NONE is not set
CONFIG_CLIPDEBUG_WARNING=y
# CONFIG_CLIPDEBUG_ERROR is not set
# end of TarableSSD1306

##################################
## Below is FeatherS2 Specific: ##
##################################
CONFIG_ESP32S2_SPIRAM_SUPPORT=y

#
# SPI RAM config
#
CONFIG_SPIRAM_TYPE_ESPPSRAM64=y
CONFIG_SPIRAM_SIZE=8388608

#
# PSRAM clock and cs IO for ESP32S2
#
CONFIG_DEFAULT_PSRAM_CLK_IO=30
CONFIG_DEFAULT_PSRAM_CS_IO=26
# end of PSRAM clock and cs IO for ESP32S2

CONFIG_SPIRAM_SPEED_80M=y
CONFIG_SPIRAM=y
CONFIG_SPIRAM_BOOT_INIT=y
CONFIG_SPIRAM_USE_MALLOC=y
CONFIG_SPIRAM_MEMTEST=y
CONFIG_SPIRAM_MALLOC_ALWAYSINTERNAL=4096
CONFIG_SPIRAM_TRY_ALLOCATE_WIFI_LWIP=y
CONFIG_SPIRAM_MALLOC_RESERVE_INTERNAL=32768
# end of SPI RAM config

#
# Wi-Fi
#
CONFIG_ESP32_WIFI_STATIC_TX_BUFFER=y
CONFIG_ESP32_WIFI_TX_BUFFER_TYPE=0
CONFIG_ESP32_WIFI_STATIC_TX_BUFFER_NUM=16
# end of Wi-Fi

#
# FAT Filesystem support
#
CONFIG_FATFS_ALLOC_PREFER_EXTRAM=y
# end of FAT Filesystem support

#
# TCP
#
# CONFIG_LWIP_WND_SCALE is not set
# end of TCP

#
# Serial flasher config
#
CONFIG_ESPTOOLPY_FLASHSIZE_4MB=y
CONFIG_ESPTOOLPY_FLASHSIZE="4MB"
# end of Serial flasher config


#
# Cache config
#
CONFIG_ESP32S2_DATA_CACHE_8KB=y
# end of Cache config
```
